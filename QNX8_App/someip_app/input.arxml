AUTOSAR XML (schema 4-2-2)
package /ExampleApp/PortInterfaces
  service interface ExampleService_SI: service-interface-id=1234, is-service=true
    event group ExampleEventGroup: event-group-id=1, event=ExampleEvent
  service interface ExampleConsumer_SI: service-interface-id=2345, is-service=true
    event group ExampleConsumerEventGroup: event-group-id=2, event=ExampleConsumerEvent
package /ExampleApp/SystemDeployment
  provided service instance ExampleService_ProvidedInstance: service-interface=ExampleService_SI, service-interface-deployment=ExampleService_SomeipDeployment, instance-identifier=1
  required service instance ExampleConsumer_RequiredInstance: service-interface=ExampleConsumer_SI, service-interface-deployment=ExampleConsumer_SomeipDeployment, instance-identifier=2
package /ExampleApp/SomeipDeployment
  someip service interface deployment ExampleService_SomeipDeployment: service-interface=ExampleService_SI, service-interface-id=1234, service-interface-version={major-version=1, minor-version=0}, someip-method-deployment{method=ExampleMethod, method-id=1, transport-protocol=UDP}, someip-event-deployment{event=ExampleEvent, event-id=32769, transport-protocol=UDP}, someip-event-group-deployment{event-group=ExampleEventGroup, event-group-id=1}
  someip service interface deployment ExampleConsumer_SomeipDeployment: service-interface=ExampleConsumer_SI, service-interface-id=2345, service-interface-version={major-version=1, minor-version=0}, someip-event-deployment{event=ExampleConsumerEvent, event-id=32770, transport-protocol=UDP}, someip-event-group-deployment{event-group=ExampleConsumerEventGroup, event-group-id=2}
package /ExampleApp/NetworkConfig
  someip service instance to machine mapping ExampleService_NetworkMapping: service-instance=ExampleService_ProvidedInstance, instance-id=1, unicast-ip-address=10.20.30.42, port-number=30501, protocol=UDP, multicast-ip-address=224.224.224.245, multicast-port-number=30490, sd-port-number=30490
  someip service instance to machine mapping ExampleConsumer_NetworkMapping: service-instance=ExampleConsumer_RequiredInstance, instance-id=2, unicast-ip-address=10.20.30.42, port-number=30502, protocol=UDP, multicast-ip-address=224.224.224.246, multicast-port-number=30491, sd-port-number=30490
